/dts-v1/;
/plugin/;
/{
	compatible = "ti,beaglebone", "ti,beaglebone-black";

	part-number = "WS2812";
	version = "00A0";

	/* This overlay use the following resources */
	exclusive-use = "P9.27", "pru0";

	fragment@0 {
		target = <&am33xx_pinmux>;
		__overlay__ {

			pru_pru_pins: pinmux_pru_pru_pins {	// The PRU pins modes
				pinctrl-single,pins = <
					0x1a4 0x05	// P9_27 pr1_pru0_pru_r30_5, MODE5 output pull-down
				>;
			};
		};
	};

	fragment@1 {	// Enable the PRUSS
		target = <&pruss>;
		__overlay__ {
			status = "okay";
			pinctrl-names = "default";
			pinctrl-0 = <&pru_pru_pins>;
		};
	};
};

